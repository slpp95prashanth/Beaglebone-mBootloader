## Kconfig
```kconfig
menu Arch
source "../arch/arm/Kconfig"
endmenu

source "../drivers/Kconfig"

menu "Debug system"

config DEBUG
    bool "debug info"
    default n

config DEBUG_PRINTF
    bool "printf function"
    default n

endmenu

config SHELL
    bool "shell"
    default y

source "../shell/Kconfig"
```

## arch/arm/Kconfig
```kconfig
config STACK_PTR
    hex "Stack pointer"
    default 0x402fffff

menu EXCEPTION

config EXCEPTION
    bool "Exception"
    default y

config EXP_STACK_START_IN
    depends on EXCEPTION
    hex "exception stackpointer"
    default 0x402ff000

config COREDUMP
    depends on EXCEPTION
    bool "coredump"
    default n

menu IRQ

config IRQ
    depends on EXCEPTION
    bool "IRQs"
    default y

config DEBUG_IRQ
    depends on COREDUMP
    depends on EXCEPTION
    depends on IRQ
    bool "debug prints in irq"
    default n

endmenu

endmenu
```

## bootstrap/Kconfig
```kconfig
menu bootstrap

config BOOTSTRAP
    bool "Bootstrap image"
    default n

config LOADADDR__DDR
    depends on BOOTSTRAP
    hex "LOADADDR_DDR"
    default 0x80000000

config MALLOC_ADDR
    hex "Heap memory"
    default 0x88000000

endmenu
```

## drivers/Kconfig
```kconfig
menu Drivers

config TIMER
    bool "timer"
    default n

menu GPIO

config GPIO
    bool "gpio"
    default n

config DEBUG_GPIO
    depends on GPIO
    bool "debug prints"
    default n

endmenu

config DDR
    bool "ddr"
    default n

menu UART

config SERIAL_UART
    bool "serial communications"
    default y

config UART1
    depends on SERIAL_UART
    bool "uart1"
    default n

endmenu

endmenu
```

## scripts/Kconfig
```kconfig
#
# For a description of the syntax of this configuration file,
# see Documentation/kbuild/kconfig-language.txt.
#

# Thanks to https://github.com/embedded-it/kbuild-template

#config SRCARCH
#	string
#	option env="SRCARCH"

#source "arch/$SRCARCH/Kconfig"

source "../Kconfig"
```

## shell/Kconfig
```kconfig
menu "shell commands"
    depends on SHELL

config SHELL_REGDUMP
    bool "Regdump command"
    default y

config SHELL_MD
    bool "md command"
    default y

config SHELL_MM
    bool "mm command"
    default y

config SHELL_GPIO
    depends on GPIO
    bool "gpio command"
    default y

config SHELL_RESET
    bool "reset command"
    default y

endmenu

#
#CMDS:= -DSHELL_REGDUMP -DSHELL_MD -DSHELL_MM -DSHELL_RESET -DSHELL_GPIO

#-DDEBUG_IRQ -DDEBUG_PRINTF
#DEBUG_FLAGS:= -DDEBUG_PRINTF

#CFLAGS+= -DSERIAL_UART -DSHELL $(CMDS) $(DEBUG_FLAGS) -DEXCEPTION -DCRASHDUMP -DGPIO -DTIMER -DIRQ \
#                -DSTACK_PTR=$(STACK_PTR) -DEXP_STACK_START_IN=$(EXP_STACK_START_IN)
```
